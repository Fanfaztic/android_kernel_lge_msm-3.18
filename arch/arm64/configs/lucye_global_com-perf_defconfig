## arch/arm64/configs/lucye_global_com-perf_defconfig
```kconfig
include lucye_global_com_common
include lucye_common-perf
CONFIG_CPU_FREQ_GOV_ELEMENTALX=y
CONFIG_CPU_FREQ_GOV_ZZMOOVE=y
CONFIG_CPU_FREQ_GOV_INTERACTIVEX=y
CONFIG_ADRENO_IDLER=y
CONFIG_CPU_WAKE_BOOST=y
CONFIG_DYNAMIC_STUNE_BOOST=y
CONFIG_MSM_PERFORMANCE=y
```
